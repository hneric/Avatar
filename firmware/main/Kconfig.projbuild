## firmware/main/Kconfig.projbuild
```kconfig
menu "Korvo-1 Network"

config KORVO_WIFI_SSID
    string "WiFi SSID"
    default ""
    help
        WiFi SSID used by the standalone ESP32-S31-Korvo-1 firmware.

config KORVO_WIFI_PASSWORD
    string "WiFi password"
    default ""
    help
        WiFi password. Leave empty for an open network.

config KORVO_BLE_PROV_POP
    string "BLE provisioning proof of possession"
    default "s31pop"
    help
        Proof-of-possession used by BLE Wi-Fi provisioning security version 1.

config KORVO_WS_HOST
    string "WebSocket host"
    default "120.25.213.109"
    help
        Hostname or IP address of the xiaozhi WebSocket backend.

config KORVO_WS_PORT
    int "WebSocket port"
    default 8989

config KORVO_WS_PATH
    string "WebSocket path"
    default "/xiaozhi/v1/"

config KORVO_WS_TOKEN
    string "WebSocket authorization token"
    default ""
    help
        Optional Authorization header value.

endmenu
```

## firmware/sdkconfig.defaults
```kconfig
CONFIG_IDF_TARGET="esp32s31"
CONFIG_ESPTOOLPY_FLASHSIZE_16MB=y
CONFIG_ESPTOOLPY_FLASHSIZE="16MB"

CONFIG_COMPILER_OPTIMIZATION_SIZE=y
CONFIG_COMPILER_CXX_EXCEPTIONS=y
CONFIG_COMPILER_CXX_EXCEPTIONS_EMG_POOL_SIZE=1024

CONFIG_BOOTLOADER_COMPILER_OPTIMIZATION_PERF=y
CONFIG_BOOTLOADER_LOG_LEVEL_NONE=y
CONFIG_BOOTLOADER_SKIP_VALIDATE_ALWAYS=y

# PSRAM (16MB Octal PSRAM on WROOM-3)
CONFIG_SPIRAM=y
CONFIG_SPIRAM_MODE_OCT=y
CONFIG_SPIRAM_SPEED_250M=y
CONFIG_SPIRAM_USE_CAPS_ALLOC=y

CONFIG_PARTITION_TABLE_OFFSET=0x8000
CONFIG_PARTITION_TABLE_CUSTOM=y
CONFIG_PARTITION_TABLE_CUSTOM_FILENAME="partitions.csv"
CONFIG_PARTITION_TABLE_FILENAME="partitions.csv"

CONFIG_KORVO_WS_HOST="120.25.213.109"
CONFIG_KORVO_WS_PORT=8989
CONFIG_KORVO_WS_PATH="/xiaozhi/v1/"
CONFIG_KORVO_WS_TOKEN=""

CONFIG_ESP_TASK_WDT_TIMEOUT_S=10
CONFIG_FREERTOS_GENERATE_RUN_TIME_STATS=y

CONFIG_ESP_MAIN_TASK_STACK_SIZE=8192
CONFIG_MBEDTLS_DYNAMIC_BUFFER=y
CONFIG_MBEDTLS_SSL_KEEP_PEER_CERTIFICATE=n

# LVGL
CONFIG_LV_OS_NONE=y
CONFIG_LV_USE_CLIB_MALLOC=y
CONFIG_LV_USE_CLIB_STRING=y
CONFIG_LV_USE_CLIB_SPRINTF=y
CONFIG_LV_BUILD_EXAMPLES=n
CONFIG_LV_BUILD_DEMOS=n
CONFIG_LV_FONT_SOURCE_HAN_SANS_SC_16_CJK=y
CONFIG_LV_FONT_DEFAULT_SOURCE_HAN_SANS_SC_16_CJK=y
CONFIG_LV_FONT_FMT_TXT_LARGE=y
CONFIG_LV_USE_IMGFONT=y
```
